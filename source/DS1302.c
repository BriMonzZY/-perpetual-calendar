#include "config.h"
#include "DS1302.h"
#include "LCD1602.h"

/*=================================================
*函数名称：DS1302_W_Byte
*函数功能：DS1302写一字节数据
*输入：dat：要写入的数据
=================================================*/
void DS1302_W_Byte(uint8 dat)
{
	uint8 i;
	for(i = 0; i < 8; i++) //每次写1bit，写8次
	{
		TSCLK = 0;		   //拉低时钟总线
		TIO = dat & 0x01;  //从一字节最低位开始写
		TSCLK = 1;		   //拉高时钟总线，DS1302把数据读走
		dat >>= 1;		   //数据右移一位 
	}	
}
/*=================================================
*函数名称：DS1302_R_Byte
*函数功能：DS1302读一字节
*输出：dat：读取的数据
=================================================*/
uint8 DS1302_R_Byte()
{
	uint8 i, dat;
	for(i = 0; i < 8; i++)  //每次写1bit，写8次
	{
		TSCLK = 0;			//拉低时钟总线，DS1302把数据放到数据总线上
		dat >>= 1; 			//数据右移一位，数据从最低位开始读 
		if(TIO)	dat |= 0x80;//读取数据
		TSCLK = 1;			//拉高时钟总线
	}
	return dat;				//返回读取的数据
}
/*=================================================
*函数名称：DS1302_W_DAT
*函数功能：写DS1302数据一次写2个字节
*说明：先写命令后写数据
*调用：DS1302_W_Byte()
*输入：cmd：需要写的命令 ，dat：需要些的数据
=================================================*/
void DS1302_W_DAT(uint8 cmd, uint8 dat)
{
	TRST = 0;			 //
	TRST = 1;			 //TRST上升沿开始读写数据
	DS1302_W_Byte(cmd);	 //写命令
	DS1302_W_Byte(dat);	 //写数据
	TRST = 0;			 //禁止读写数据
}
/*=================================================
*函数名称：DS1302_R_DAT
*函数功能：读DS1302数据
*说明：先写入命令字节后读出对应数据
*调用：	DS1302_W_Byte();DS1302_R_Byte();
*输入：	cmd：需要写的命令
*输出：	dat：读出的数据
=================================================*/
/*uint8 DS1302_R_DAT(uint8 cmd)	//此程序中未使用此函数
{
	uint8 dat;
	TRST = 0;			 	//
	TRST = 1;				//TRST上升沿开始读写数据
	DS1302_W_Byte(cmd);		//写命令
	dat = DS1302_R_Byte();	//读出数据
	TRST = 0;			 	//禁止读写数据
	return dat;				//返回读出数据
}  */
/*=================================================
*函数名称：DS1302_Clear_WP
*函数功能：清除DS1302写保护
*说明：先写入命令0x8e（写控制寄存器）接着向该寄存器写0
*调用：DS1302_W_DAT()
=================================================*/
void DS1302_Clear_WP()
{
	DS1302_W_DAT(0x8e,0x00);  //把控制寄存器WP位置0
}
/*=================================================
*函数名称：DS1302_Set_WP
*函数功能：设置DS1302写保护
*说明：先写入命令0x8e（写控制寄存器）接着向该寄存器写0x80
*调用：DS1302_W_DAT()
=================================================*/
void DS1302_Set_WP()
{	
	DS1302_W_DAT(0x8e,0x80); //把控制寄存器WP位置1
	TRST = 0;				 //拉低使能端
	TSCLK = 0;				 //拉低数据总线
} 
/*=================================================
*函数名称：DS1302_Burst_Write
*函数功能：突发模式写DS1302时钟日历数据
*说明：写入8个字节的数据到DS1302时钟日历寄存器中
*调用：DS1302_Clear_WP();DS1302_W_Byte();DS1302_Set_WP();
=================================================*/
void DS1302_Burst_Write(uint8 *dat)
{
	uint8 i;
	DS1302_Clear_WP();		//清除写保护
	TRST = 0;			 	//拉低使能端
	TSCLK = 0;				//拉低数据总线
	TRST = 1;				//拉高使能端，开始写数据
	DS1302_W_Byte(0xbe); //写时钟突发模式寄存器
	for(i = 0; i < 8; i++)	//写入8个字节的时钟初始值
	{
		DS1302_W_Byte(dat[i]); //在突发模式下可以连续写数据
	}
	DS1302_Set_WP(); //开起写保护		
}
/*=================================================
*函数名称：DS1302_Burst_Read
*函数功能：突发模式读DS1302时钟日历数据
*说明：	读取8个字节的DS1302时钟日历数据
		数组TimeData（数据格式BCD码）
*调用：DS1302_Clear_WP();DS1302_R_Byte();DS1302_Set_WP();
=================================================*/
void DS1302_Burst_Read(uint8 *dat)
{
	uint8 i;
	DS1302_Clear_WP();    	//清除写保护
	TRST = 0;			 	//拉低使能端
	TSCLK = 0;				//拉低数据总线
	TRST = 1;				//拉高使能端，开始写数据
	DS1302_W_Byte(0xbf); //写 读突发模式寄存器命令
	for(i = 0; i < 8; i++)	//从DS1302读取7个字节的时钟日历数据
	{
		dat[i] = DS1302_R_Byte();//在突发模式下可以连续读数据
	}
	DS1302_Set_WP();   //开起写保护
}
/*=================================================
*函数名称：GetRealTime
*函数功能：突发模式读DS1302时钟日历数据，并转为时间格式
=================================================*/
void GetRealTime(struct sTime *time)
{
    uint8 buf[8];
    
    DS1302_Burst_Read(buf);
    time->year = buf[6] + 0x2000;  //年，因为DS1302只能是0-99如显示2012年则通过2000这种方法显示年的千位和百位
    time->mon  = buf[4];
    time->day  = buf[3];
    time->hour = buf[2];
    time->min  = buf[1];
    time->sec  = buf[0];
    time->week = buf[5];
}
/*=================================================
*函数名称：SetRealTime
*函数功能：突发模式设置DS1302时钟日历数据
=================================================*/ 
void SetRealTime(struct sTime *time)
{
    uint8 buf[8];
    
    buf[7] = 0;
    buf[6] = time->year;
    buf[5] = time->week;
    buf[4] = time->mon;
    buf[3] = time->day;
    buf[2] = time->hour;
    buf[1] = time->min;
    buf[0] = time->sec;
    DS1302_Burst_Write(buf);
}
/*=================================================
*函数名称：Init_DS1302
*函数功能：初始化DS1302并设置默认时间 ：2017-08-01 23:59:50 星期二
=================================================*/ 
void Init_DS1302()
{
    struct sTime code InitTime[] = { 
        0x2017 , 0x08, 0x01, 0x23, 0x59, 0x50, 0x02
    };	
	
    SetRealTime(&InitTime);      //设置DS1302为默认的初始时间
}