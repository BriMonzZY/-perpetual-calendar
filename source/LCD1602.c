/*
	LCD1602显示底层驱动
*/


#include "config.h"
#include "LCD1602.h"

/*=================================================
*函数名称：Read_Busy
*函数功能：判断1602液晶忙，并等待
=================================================*/
void Read_Busy()
{
	uint8 busy;
	LCD1602_DB = 0xff;//复位数据总线
	LCD1602_RS = 0;	  //拉低RS
	LCD1602_RW = 1;	  //拉高RW读
	do
	{
		LCD1602_EN = 1;//使能EN
		busy = LCD1602_DB;//读回数据
		LCD1602_EN = 0;	 //拉低使能以便于下一次产生上升沿
	}while(busy & 0x80); //判断状态字BIT7位是否为1，为1则表示忙，程序等待
}
/*=================================================
*函数名称：LCD1602_Write_Cmd
*函数功能：写LCD1602命令
*调用：Read_Busy();
*输入：cmd:要写的命令
=================================================*/
void LCD1602_Write_Cmd(uint8 cmd)
{
	Read_Busy();	 //判断忙，忙则等待
	LCD1602_RS = 0;	 //选择为写命令
	LCD1602_RW = 0;	//模式为写
	LCD1602_DB = cmd;//写入命令
	LCD1602_EN = 1;	 //拉高使能端 数据被传输到LCD1602内
	LCD1602_EN = 0;	 //拉低使能以便于下一次产生上升沿
}
/*=================================================
*函数名称：LCD1602_Write_Dat
*函数功能：写LCD1602数据
*调用：Read_Busy();
*输入：dat：需要写入的数据
=================================================*/
void LCD1602_Write_Dat(uint8 dat)
{
	Read_Busy();  //判断忙，忙则等待
	LCD1602_RS = 1;	//选择为写数据
	LCD1602_RW = 0;	//模式为写
	LCD1602_DB = dat; //写入8位数据
	LCD1602_EN = 1;	  //拉高使能端 数据被传输到LCD1602内
	LCD1602_EN = 0;	  //拉低使能以便于下一次产生上升沿
}
/*=================================================
*函数名称：LCD1602_Clear_Screen
*函数功能：清屏
=================================================*/
void LCD1602_Clear_Screen()
{
	LCD1602_Write_Cmd(0x01);
}
/*=================================================
*函数名称：LCD1602_Open_Cursor
*函数功能：打开光标的闪烁效果
=================================================*/
void LCD1602_Open_Cursor()
{
	LCD1602_Write_Cmd(0x0F);
}
/*=================================================
*函数名称：LCD1602_Close_Cursor
*函数功能：关闭光标显示
=================================================*/
void LCD1602_Close_Cursor()
{
	LCD1602_Write_Cmd(0x0C);
}
/*=================================================
*函数名称：LCD1602_Set_Cursor
*函数功能：在指定位置显示光标,设置RAM起始位置
*调用：LCD1602_Write_Cmd();
*输入：x：要显示的横坐标取值0-40，y：要显示的行坐标取值0-1（0为第一行,1为第二行）
=================================================*/
void LCD1602_Set_Cursor(uint8 x, uint8 y)
{
	if(y) x |= 0x40;
	x |= 0x80;
	LCD1602_Write_Cmd(x);
}
/*=================================================
*函数名称：LCD1602_Dis_OneChar
*函数功能：在指定位置显示一个字符
*调用：LCD1602_Set_Cursor(x, y); LCD1602_Write_Dat();	
*输入：x：要显示的横坐标取值0-40，y：要显示的行坐标取值0-1（0为第一行,1为第二行）
		dat：需要显示的数据以ASCLL形式显示
=================================================*/
void LCD1602_Dis_OneChar(uint8 x, uint8 y, uint8 dat)
{
	LCD1602_Set_Cursor(x, y);//设置RAM起始位置
	LCD1602_Write_Dat(dat);	 //写入一个字节的数据	
}
/*=================================================
*函数名称：LCD1602_Dis_Str
*函数功能：在指定位置显示字符串
*调用：LCD1602_Set_Cursor(x, y); LCD1602_Write_Dat();
*输入：x：要显示的横坐标取值0-40，y：要显示的行坐标取值0-1（0为第一行,1为第二行）
		*str：需要显示的字符串
=================================================*/
void LCD1602_Dis_Str(uint8 x, uint8 y, uint8 *str)
{
	LCD1602_Set_Cursor(x, y);//设置RAM起始位置
	while(*str != '\0')	     //写入字符串数据
	{
		LCD1602_Write_Dat(*str++);
	}
}
/*=================================================
*函数名称：Init_LCD1602
*函数功能：1602初始化
*调用：	LCD1602_Write_Cmd();
=================================================*/
void Init_LCD1602()
{
	LCD1602_Write_Cmd(0x38); //	设置16*2显示，5*7点阵，8位数据接口
	LCD1602_Write_Cmd(0x0c); //开显示,关闭光标
	LCD1602_Write_Cmd(0x06); //读写一字节后地址指针加1
	LCD1602_Write_Cmd(0x01); // 清屏
}